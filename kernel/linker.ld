ENTRY(aetheria_main);
SECTIONS { . = 0x00000000; .text : { *(.text.entry) *(.text*) } .rodata : { *(.rodata*) } .data : { *(.data*) } .bss : { *(.bss*) *(COMMON) } /DISCARD/ : { *(.eh_frame) *(.comment) } }
